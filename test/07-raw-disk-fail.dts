/* SPDX-License-Identifier: GPL-2.0-only */
/* Copyright 2023 The DT-Utils Authors <oss-tools@pengutronix.de> */
/dts-v1/;

#include "barebox-state.dtsi"

/ {
	disk: loopfile {
		compatible = "barebox,hostfile";
		barebox,filename = __RAW_LOOPDEV__;
		barebox,blockdev;
	};
};

&state {
	backend = <&disk>;
	backend-type = "raw";
	backend-stridesize = <0x40>;
	backend-storage-type = "direct";
};
